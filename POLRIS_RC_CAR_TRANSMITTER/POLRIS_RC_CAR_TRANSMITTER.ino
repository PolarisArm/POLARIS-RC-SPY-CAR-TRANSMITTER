#include <Arduino.h>
#include <Adafruit_GFX.h>
#include <Adafruit_SSD1306.h>
#include <RF24.h>

#define CE         9
#define CSN       10
#define ROLL      A1
#define PITCH     A0
#define YAW       A2
#define THROTTLE  A3
#define SW1        5
#define SW2        6
#define POT1      A6
#define POT2      A7
#define TRCAL      3
#define YACAL      7
#define PICAL      4
#define ROCAL      8


#define SCREEN_WIDTH 128 // OLED display width, in pixels
#define SCREEN_HEIGHT 64 // OLED display height, in pixels

#define OLED_RESET     -1 // Reset pin # (or -1 if sharing Arduino reset pin)
#define SCREEN_ADDRESS 0x3C /// 0x3C for 128x64
Adafruit_SSD1306 display(SCREEN_WIDTH, SCREEN_HEIGHT);

const unsigned char WELCOME_SCREEN [] PROGMEM = {
	0xff, 0xff, 0xff, 0xff, 0xff, 0xff, 0xff, 0xff, 0xff, 0xff, 0xff, 0xff, 0xff, 0xff, 0xff, 0xff, 
	0xff, 0xff, 0xff, 0xff, 0xff, 0xff, 0xff, 0xff, 0xff, 0xff, 0xff, 0xff, 0xff, 0xff, 0xff, 0xff, 
	0xff, 0xff, 0xff, 0xff, 0xff, 0xff, 0xff, 0xff, 0xff, 0xff, 0xff, 0xff, 0xff, 0xff, 0xff, 0xff, 
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	0xff, 0xff, 0xff, 0xff, 0xff, 0xff, 0xff, 0xff, 0xff, 0xff, 0xff, 0xff, 0xff, 0xff, 0xff, 0xff
};


const unsigned char HOME [] PROGMEM = {
	0x00, 0x00, 0x00, 0x00, 0x00, 0x00, 0x00, 0x00, 0x00, 0x00, 0x00, 0x00, 0x00, 0x00, 0x00, 0x00, 
	0xff, 0xff, 0xff, 0xff, 0xff, 0xff, 0xff, 0xff, 0xff, 0xff, 0xff, 0xff, 0xff, 0xff, 0xff, 0xfc, 
	0x80, 0x00, 0x00, 0x00, 0x00, 0x00, 0x00, 0x00, 0x00, 0x00, 0x38, 0x00, 0x00, 0x00, 0x00, 0x04, 
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	0x00, 0x00, 0x00, 0x00, 0x00, 0x00, 0x00, 0x00, 0x00, 0x00, 0x00, 0x00, 0x00, 0x00, 0x00, 0x00
};

const unsigned char DIGI_CLICKED [] PROGMEM = {
	0xff, 0xc0, 0xff, 0xc0, 0xff, 0xc0, 0xff, 0xc0, 0xff, 0xc0, 0xff, 0xc0, 0xff, 0xc0, 0xff, 0xc0, 
	0xff, 0xc0, 0xff, 0xc0
};

unsigned long previousCurrentTime = 0,previousTime = 0;

const uint64_t address = 0XE8E8F0F0E1LL;

RF24 radio(CE,CSN);

struct CHANNEL_DATA{
  byte throttle;
  byte yaw;
  byte roll;
  byte pitch;
  byte pot1;
  byte pot2;
  byte sw1;
  byte sw2;
};

CHANNEL_DATA data;

void send_data();
void display_data();

void setup() {
  // put your setup code here, to run once:
  pinMode(THROTTLE,INPUT);
  pinMode(YAW     ,INPUT);
  pinMode(ROLL    ,INPUT);
  pinMode(PITCH   ,INPUT);
  pinMode(POT1    ,INPUT);
  pinMode(POT2    ,INPUT);
  pinMode(SW1     ,INPUT);
  pinMode(SW2     ,INPUT);
  pinMode(TRCAL   ,INPUT);
  pinMode(YACAL   ,INPUT);
  pinMode(ROCAL   ,INPUT);
  pinMode(PICAL   ,INPUT);

  Wire.begin();
  Serial.begin(115200);
  if (!radio.begin()) {
    Serial.println(F("radio hardware is not responding!!"));
    while (1) {}  // hold in infinite loop
  }
  radio.setDataRate(RF24_250KBPS);
  radio.setPALevel(RF24_PA_MIN);
  radio.openWritingPipe(address);
  radio.stopListening();

  data.throttle = 127;
  data.yaw      = 127;
  data.roll     = 127;
  data.pitch    = 127;
  data.pot1     = 127;
  data.pot2     = 127;
  data.sw1      = 0;
  data.sw2      = 0;
  
  // SSD1306_SWITCHCAPVCC = generate display voltage from 3.3V internally
  display.setRotation(2);

  if(!display.begin(SSD1306_SWITCHCAPVCC, SCREEN_ADDRESS)) {
    Serial.println(F("SSD1306 allocation failed"));
    for(;;); // Don't proceed, loop forever
  }
  display.clearDisplay();
  delay(100); 
  display.clearDisplay();
  display.drawBitmap(0,0,WELCOME_SCREEN,128,64,SSD1306_WHITE);
  display.display();
  delay(500); 
  display.clearDisplay();
}

void loop() {
  send_data();
  display_data();  
  delayMicroseconds(100);
}

void send_data()
{
  data.throttle = map(analogRead(THROTTLE),0,1023,0,255);
  data.yaw      = map(analogRead(YAW)     ,0,1023,0,255);
  data.roll     = map(analogRead(ROLL)    ,0,1023,0,255);
  data.pitch    = map(analogRead(PITCH)   ,0,1023,0,255);
  data.pot1     = map(analogRead(POT1)    ,0,1023,0,255);  
  data.pot2     = map(analogRead(POT2)    ,0,1023,0,255);
  data.sw1      = digitalRead(SW1);
  data.sw2      = digitalRead(SW2);
  radio.write(&data,sizeof(CHANNEL_DATA));
 // Serial.println("SENT DATA");
}

void display_data()
{
    display.clearDisplay();
    display.drawBitmap(0,0,HOME,128,64,SSD1306_WHITE);

  
	if(data.sw1 == LOW)
      {
	display.drawBitmap( 92, 45,DIGI_CLICKED, 10,10,SSD1306_WHITE );   
      }
			
     if(data.sw2 == LOW)
      {
	display.drawBitmap( 110,45,DIGI_CLICKED, 10, 10, SSD1306_WHITE);
      }
			
      display.setTextSize(1); // Draw 2X-scale text
      display.setTextColor(SSD1306_WHITE);
      display.setCursor(24,4);
      display.print(data.throttle); 
      display.setCursor(24,13);
      display.print(data.yaw);
      display.setCursor(24,22);
      display.print(data.roll);
      display.setCursor(24,31);
      display.print(data.pitch);
      display.setCursor(24,40);
      display.print(data.pot1);
      display.setCursor(24,49);
      display.print(data.pot2);
      display.display();  
}


